const int turnLeftGait[] = {
  29,  26,  29,  26,  27,  22,  27,  22,
  28,  26,  30,  26,  27,  21,  27,  24,
  27,  26,  31,  25,  28,  22,  28,  25,
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  29,  26,  29,  26,  27,  22,  27,  22,
};

void turnLeft() {
  for (int i = 0; i < sizeof(turnLeftGait) / sizeof(turnLeftGait[0]); i += NUM_JOINTS - 1) {
    for (int j = 1; j < NUM_JOINTS; j++) {
      servoSetAngle(j, zeroPositionAngles[j] + turnLeftGait[i + j - 1] * rotationDirection[j]);
    }
    delay(1);
  }
  Serial.println("turn left");
}

void turnRight() {
  for (int i = 0; i < sizeof(turnLeftGait) / sizeof(turnLeftGait[0]); i += NUM_JOINTS - 1) {
    for (int j = 1; j < NUM_JOINTS; j++) {
      if (j % 2 == 1) {
        servoSetAngle(j, zeroPositionAngles[j] + turnLeftGait[i + j] * rotationDirection[j]);
      } else {
        servoSetAngle(j, zeroPositionAngles[j] + turnLeftGait[i + j - 2] * rotationDirection[j]);
      }
    }
    delay(1);
  }
  Serial.println("turn right");
}
